## conf/layer.conf
```bitbake
#
# Copyright (C) 2016-2017 Wind River Systems, Inc.
#

# We have a conf and classes directory, add to BBPATH
BBPATH =. "${LAYERDIR}:"

# We have a packages directory, add to BBFILES
BBFILES += "${LAYERDIR}/recipes-*/*/*.bb \
        ${LAYERDIR}/recipes-*/*/*.bbappend"

BBFILE_COLLECTIONS += "wr-secure-env"
BBFILE_PATTERN_wr-secure-env = "^${LAYERDIR}/"
BBFILE_PRIORITY_wr-secure-env = "7"

LAYERDEPENDS_wr-secure-env = "\
    core \
    secure-core \
"
```
